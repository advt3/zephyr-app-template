## CMakeLists.txt
```
cmake_minimum_required(VERSION 3.20.0)
find_package(Zephyr REQUIRED HINTS $ENV{ZEPHYR_BASE})
project(zephyr_app_template)

target_include_directories(app PRIVATE include)
target_sources(app PRIVATE src/main.cpp)
```

## prj.conf
```kconfig
CONFIG_SERIAL=y
CONFIG_CONSOLE=y
CONFIG_UART_CONSOLE=y
CONFIG_LOG=y
CONFIG_LOG_BACKEND_UART=y
CONFIG_LOG_DEFAULT_LEVEL=3
CONFIG_CPP=y
CONFIG_STD_CPP14=y
```

## src/main.cpp
```c
#include <zephyr/kernel.h>
#include <zephyr/logging/log.h>

LOG_MODULE_REGISTER(main, LOG_LEVEL_INF);

extern "C" int main() {
    LOG_INF("Zephyr app template started.");
}
```

## include/MyWorker.h
```c
#pragma once

class MyWorker {
public:
    void run();
};
```

## src/MyWorker.cpp
```c
#include "MyWorker.h"

void MyWorker::run() {
    // placeholder work
}
```
